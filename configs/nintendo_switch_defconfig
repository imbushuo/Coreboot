## configs/nintendo_switch_defconfig
```kconfig
CONFIG_ANY_TOOLCHAIN=y
CONFIG_USE_BLOBS=y
CONFIG_VENDOR_NINTENDO=y
# CONFIG_POST_DEVICE is not set
CONFIG_COREBOOT_ROMSIZE_KB_1024=y
CONFIG_CONSOLE_SERIAL_TEGRA210_UARTB=y
CONFIG_HAVE_MTC=y
CONFIG_HAVE_MTC_TABLES=y
CONFIG_MTC_TABLES_DIRECTORY="../shofel2/mtc_tables"
CONFIG_DEFAULT_CONSOLE_LOGLEVEL_6=y
CONFIG_PAYLOAD_ELF=y
CONFIG_PAYLOAD_FILE="../u-boot/u-boot.elf"
```

## src/mainboard/nintendo/switch/Kconfig
```kconfig
##
## This file is part of the coreboot project.
##
## Copyright 2015 Google Inc.
##
## This program is free software; you can redistribute it and/or modify
## it under the terms of the GNU General Public License as published by
## the Free Software Foundation; version 2 of the License.
##
## This program is distributed in the hope that it will be useful,
## but WITHOUT ANY WARRANTY; without even the implied warranty of
## MERCHANTABILITY or FITNESS FOR A PARTICULAR PURPOSE.  See the
## GNU General Public License for more details.
##

if BOARD_NINTENDO_SWITCH

config BOARD_SPECIFIC_OPTIONS # dummy
	def_bool y
	select BOARD_ROMSIZE_KB_16384
	select MAINBOARD_HAS_NATIVE_VGA_INIT
	select MAINBOARD_FORCE_NATIVE_VGA_INIT
	select SOC_NVIDIA_TEGRA210
	select MAINBOARD_DO_DSI_INIT

config BOOTBLOCK_WRAP_BCT
	def_bool n

config MAINBOARD_DIR
	string
	default nintendo/switch

config MAINBOARD_PART_NUMBER
	string
	default "Switch"

config DRAM_SIZE_MB
	int
	default 4096

endif # BOARD_NINTENDO_SWITCH
```
